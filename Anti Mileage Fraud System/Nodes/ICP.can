/*@!Encoding:1252*/
includes
{
  //#include "..\DataSources\ASNV_Template_BaseDatatypes.cin"
}

variables {
    message 0x100 mileageInc;
    message 0x200 mileageTotal;
    long mileageCounter = 0;
}



on start
{
  
}




on message 0x100 {
    mileageCounter += this.mileage;
    write("Mileage received by ICP: %.2f km", mileageCounter / 1000.0);
}

on message 0x200 {
    mileageCounter = this.mileage_total;
    write("Total mileage received by ICP: %.2f km", mileageCounter / 1000.0);
}

