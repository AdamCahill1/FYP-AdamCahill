VERSION ""

NS_ :

BS_:

BU_: ICP Mileage_Generator

BO_ 768 mileage_tcu: 32 Mileage_Generator
 SG_ mileage_tcu : 0|32@1+ (1,0) [0|4294967295] "m" Vector__XXX

BO_ 512 mileage_total: 32 Mileage_Generator
 SG_ mileage_total : 0|32@1+ (1,0) [0|4294967295] "m"  ICP

BO_ 256 mileage_data: 32 Mileage_Generator
 SG_ mileage : 0|32@1+ (1,0) [0|4294967295] "m"  ICP

BA_DEF_ BO_  "CANFD_BRS" ENUM  "0","1";
BA_DEF_  "DBName" STRING ;
BA_DEF_  "BusType" STRING ;
BA_DEF_ BO_  "VFrameFormat" ENUM  "StandardCAN","ExtendedCAN","reserved","reserved","reserved","reserved","reserved","reserved","reserved","reserved","reserved","reserved","reserved","reserved","StandardCAN_FD","ExtendedCAN_FD";
BA_DEF_DEF_  "CANFD_BRS" "1";
BA_DEF_DEF_  "DBName" "";
BA_DEF_DEF_  "BusType" "";
BA_DEF_DEF_  "VFrameFormat" "StandardCAN";
BA_ "BusType" "CAN FD";
BA_ "DBName" "FYP_CANdb";
BA_ "VFrameFormat" BO_ 768 14;
BA_ "VFrameFormat" BO_ 512 14;
BA_ "VFrameFormat" BO_ 256 14;
